## boards/arm/macro-snap/Kconfig.board
```kconfig
# Copyright (c) 2023 Nordic Semiconductor ASA
# SPDX-License-Identifier: Apache-2.0

config BOARD_MACRO_SNAP
	bool "macro-snap"
	depends on SOC_NRF52811_QFAA
```

## boards/arm/macro-snap/Kconfig.defconfig
```kconfig
# Copyright (c) 2023 Nordic Semiconductor ASA
# SPDX-License-Identifier: Apache-2.0

if BOARD_MACRO_SNAP

config BOARD
	default "macrosnap"

config BT_CTLR
   default BT

endif
```

## boards/arm/macro-snap/macro-snap_defconfig
```kconfig
# Copyright (c) 2022 Nordic Semiconductor ASA
# SPDX-License-Identifier: Apache-2.0

CONFIG_SOC_SERIES_NRF52X=y
CONFIG_SOC_NRF52811_QFAA=y
CONFIG_BOARD_MACRO_SNAP=y

#cpp cee ur pepe
CONFIG_NEWLIB_LIBC=y
#CONFIG_MINIMAL_LIBC=y
#CONFIG_CPLUSPLUS=y
# CONFIG_LIB_CPLUSPLUS=y
#CONFIG_NEWLIB_LIBC=y
CONFIG_CPLUSPLUS=y
CONFIG_LIB_CPLUSPLUS=y
# CONFIG_STD_CPP17=y
# CONFIG_MAIN_STACK_SIZE=2048
# CONFIG_FPU=y
#CONFIG_SSE=y
# Enable MPU
CONFIG_ARM_MPU=y

# Enable hardware stack protection
CONFIG_HW_STACK_PROTECTION=y

CONFIG_GPIO=y
CONFIG_PINCTRL=y
CONFIG_GPIO_AS_PINRESET=n
#CONFIG_PWM=y
CONFIG_ADC=y
CONFIG_ADC_ASYNC=y
CONFIG_ADC_NRFX_SAADC=y
#CONFIG_SERIAL=y
CONFIG_SPI=y
# CONFIG_NRFX_SPI=y
# CONFIG_NRFX_SPI0=y #didnt error but got assigned a n
# CONFIG_NRFX_SPIM0=y
# CONFIG_SPI_NRFX=y
# CONFIG_HAS_HW_NRF_SPI0=y
# CONFIG_HAS_HW_NRF_SPIM0=y
# CONFIG_SPI_0_NRF_SPI=y
# CONFIG_SPI_0_NRF_SPIM=y

# Right now use the internal RC --> need to move to external clock source
CONFIG_CLOCK_CONTROL_NRF_K32SRC_RC=y

#bluetooth broadcaster configs 
# CONFIG_BT_PERIPHERAL=y #was broadcaster
CONFIG_BT=y
#CONFIG_BT_HCI=y
#CONFIG_BT_CTLR_ADVANCED_FEATURES=y
#CONFIG_BT_EXT_ADV=y
#CONFIG_BT_DEBUG_LOG=y #need??
CONFIG_BT_DEVICE_NAME="Grizz"
```

## macro-snap/build_1/Kconfig/Kconfig.shield
```kconfig
osource "/Users/aashmikamali/Documents/Piezosaurus/macro-snap-fw/boards/shields/*/Kconfig.shield"
osource "/opt/nordic/ncs/v2.2.0/nrf/boards/shields/*/Kconfig.shield"
```

## macro-snap/build_1/Kconfig/Kconfig.shield.defconfig
```kconfig
osource "/Users/aashmikamali/Documents/Piezosaurus/macro-snap-fw/boards/shields/*/Kconfig.defconfig"
osource "/opt/nordic/ncs/v2.2.0/nrf/boards/shields/*/Kconfig.defconfig"
```
